## firmware/main/Kconfig.projbuild
```kconfig
menu "BAD POSTURE"

    choice BADPOSTURE_BOARD
        prompt "Target board"
        default BADPOSTURE_BOARD_FREENOVE
        help
            Selects the camera / LED / buzzer / button pinout.

        config BADPOSTURE_BOARD_FREENOVE
            bool "Freenove ESP32-S3-WROOM CAM (N16R8, 16 MB flash)"
        config BADPOSTURE_BOARD_XIAO
            bool "Seeed XIAO ESP32S3 Sense (8 MB flash)"
    endchoice

    choice BADPOSTURE_ROTATE
        prompt "Camera rotation (clockwise)"
        default BADPOSTURE_ROTATE_270
        help
            270 = board standing in portrait (side-view desk setup), same as
            camera.rotate in config.yaml. The person must appear upright.

        config BADPOSTURE_ROTATE_0
            bool "0 (landscape)"
        config BADPOSTURE_ROTATE_90
            bool "90"
        config BADPOSTURE_ROTATE_180
            bool "180"
        config BADPOSTURE_ROTATE_270
            bool "270 (portrait)"
    endchoice

endmenu
```
